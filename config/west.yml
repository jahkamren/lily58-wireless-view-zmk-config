## config/west.yml
```yaml
# manifest:
#   remotes:
#     - name: zmkfirmware
#       url-base: https://github.com/jahkamren
#   projects:
#     - name: zmk-custom
#       remote: zmkfirmware
#       revision: main
#       import: app/west.yml
#   self:
#     path: config
manifest:
  remotes:
    - name: myrepo
      url-base: https://github.com/jahkamren

  projects:
    - name: zmk-custom
      repo-path: zmk-custom
      remote: myrepo
      revision: main
      path: zmk-custom

    - name: zephyr
      repo-path: zephyr-custom
      remote: myrepo
      revision: v3.5.0+zmk-fixes
      path: zephyr

  self:
    path: config
```
